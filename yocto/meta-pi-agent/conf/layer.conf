## yocto/meta-pi-agent/conf/layer.conf
```bitbake
BBPATH .= ":${LAYERDIR}"
BBFILES += "${LAYERDIR}/recipes-*/*/*.bb \
            ${LAYERDIR}/recipes-*/*/*.bbappend"

BBFILE_COLLECTIONS += "meta-pi-agent"
BBFILE_PATTERN_meta-pi-agent = "^${LAYERDIR}/"
BBFILE_PRIORITY_meta-pi-agent = "10"

LAYERVERSION_meta-pi-agent = "1"
LAYERSERIES_COMPAT_meta-pi-agent = "scarthgap"
```
